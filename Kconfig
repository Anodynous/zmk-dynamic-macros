## Kconfig
```kconfig
DT_COMPAT_ZMK_BEHAVIOR_DYNAMIC_MACRO := zmk,behavior-dynamic-macro

config ZMK_BEHAVIOR_DYNAMIC_MACRO
    bool
    default $(dt_compat_enabled,$(DT_COMPAT_ZMK_BEHAVIOR_DYNAMIC_MACRO))

if ZMK_BEHAVIOR_DYNAMIC_MACRO

config ZMK_BEHAVIOR_DYNAMIC_MACRO_MAX_EVENTS
    int "Maximum number of events a single macro can hold (press + release = 2 events)"
    default 64
    help
      Maximum events a single macro can hold. Also sizes the in-progress recording
      buffer. Must be <= AVG_EVENTS_PER_SLOT x number of slots.

config ZMK_BEHAVIOR_DYNAMIC_MACRO_AVG_EVENTS_PER_SLOT
    int "Average events per slot (sizes the shared recording pool)"
    default 32
    range 1 64
    help
      All macro slots share one recording pool sized AVG_EVENTS_PER_SLOT x number
      of slots. A single macro can be longer than this average, as long as the
      total recorded across all slots stays within the pool -- so a few long
      macros leave less room for the rest. A typical keystroke is 2 events
      (press + release). Set this equal to "Maximum events per macro" to guarantee
      every slot can be filled to the maximum at once (no pool sharing, no RAM
      savings).

config ZMK_BEHAVIOR_DYNAMIC_MACRO_TAP_DELAY
    int "Delay in ms between each event during playback"
    default 20

config ZMK_BEHAVIOR_DYNAMIC_MACRO_PLAYBACK_BUFFER
    bool "Buffer user keypresses during macro playback and drain them after"
    default y
    help
      While a macro plays, hold the user's own keypresses and type them after the
      macro finishes, in order, instead of letting them interleave. The buffer
      catches up quickly (replay is faster than typing). Keys past the buffer's
      capacity pass through live rather than being lost.

config ZMK_BEHAVIOR_DYNAMIC_MACRO_ASSIGN_TIMEOUT
    int "Timeout in ms before pending assign/delete auto-cancels"
    default 10000

config ZMK_BEHAVIOR_DYNAMIC_MACRO_PERSIST
    bool "Persist macros to NVS flash across reboots"
    default y
    depends on SETTINGS

config ZMK_BEHAVIOR_DYNAMIC_MACRO_NVS_SLOTS
    int "Number of NVS-backed dynamic macro slots"
    default 8
    range 0 16
    depends on ZMK_BEHAVIOR_DYNAMIC_MACRO_PERSIST

config ZMK_BEHAVIOR_DYNAMIC_MACRO_RAM_SLOTS
    int "Number of RAM-only dynamic macro slots"
    default 8
    range 0 48

config ZMK_BEHAVIOR_DYNAMIC_MACRO_AUTO_OVERWRITE_RAM
    bool "Automatically overwrite occupied RAM slots instead of rejecting"
    default n
    depends on ZMK_BEHAVIOR_DYNAMIC_MACRO_RAM_SLOTS > 0
    help
      Saving (or moving) a macro into an occupied RAM slot silently replaces the
      stored macro instead of reporting the slot as full. The replacement is
      feedback-free: only the normal SAVED/MOVED confirmation is emitted. When
      disabled (default) the slot must be deleted first and an occupied target is
      rejected with feedback. The occupant is cleared before the commit, so a
      commit that is refused (shared pool full) leaves the occupant already
      gone; the draft is kept for retry.

config ZMK_BEHAVIOR_DYNAMIC_MACRO_AUTO_OVERWRITE_NVS
    bool "Automatically overwrite occupied NVS slots instead of rejecting"
    default n
    depends on ZMK_BEHAVIOR_DYNAMIC_MACRO_PERSIST
    help
      As AUTO_OVERWRITE_RAM, but for the NVS-persisted slots: saving (or moving)
      a macro into an occupied NVS slot silently replaces the stored macro
      (its flash entry is removed and the new macro persisted as usual) instead
      of reporting the slot as full. Independent of the RAM variant, so the two
      slot classes can be governed separately. The occupant's flash entry is
      removed before the replacement is saved, so a save that is refused (pool
      or storage queue full) leaves the occupant already gone.

comment "Dynamic macro has zero slots; all dynamic macro slot bindings will be unusable"
    depends on ZMK_BEHAVIOR_DYNAMIC_MACRO_RAM_SLOTS = 0
    depends on !ZMK_BEHAVIOR_DYNAMIC_MACRO_PERSIST || ZMK_BEHAVIOR_DYNAMIC_MACRO_NVS_SLOTS = 0


choice ZMK_BEHAVIOR_DYNAMIC_MACRO_FEEDBACK_LEVEL_CHOICE
    prompt "Typed feedback level"
    default ZMK_BEHAVIOR_DYNAMIC_MACRO_FEEDBACK_VERBOSE

config ZMK_BEHAVIOR_DYNAMIC_MACRO_FEEDBACK_OFF
    bool "Off"

config ZMK_BEHAVIOR_DYNAMIC_MACRO_FEEDBACK_ERROR
    bool "Errors only"

config ZMK_BEHAVIOR_DYNAMIC_MACRO_FEEDBACK_COMMAND
    bool "Commands (no empty slot messages)"

config ZMK_BEHAVIOR_DYNAMIC_MACRO_FEEDBACK_BASIC
    bool "Basic"

config ZMK_BEHAVIOR_DYNAMIC_MACRO_FEEDBACK_VERBOSE
    bool "Verbose"

endchoice

config ZMK_BEHAVIOR_DYNAMIC_MACRO_FEEDBACK_LEVEL
    int
    default 0 if ZMK_BEHAVIOR_DYNAMIC_MACRO_FEEDBACK_OFF
    default 1 if ZMK_BEHAVIOR_DYNAMIC_MACRO_FEEDBACK_ERROR
    default 2 if ZMK_BEHAVIOR_DYNAMIC_MACRO_FEEDBACK_COMMAND
    default 3 if ZMK_BEHAVIOR_DYNAMIC_MACRO_FEEDBACK_BASIC
    default 4 if ZMK_BEHAVIOR_DYNAMIC_MACRO_FEEDBACK_VERBOSE

choice ZMK_BEHAVIOR_DYNAMIC_MACRO_LOCALE_CHOICE
    prompt "Host keyboard locale for typed feedback"
    default ZMK_BEHAVIOR_DYNAMIC_MACRO_LOCALE_US
    depends on !ZMK_BEHAVIOR_DYNAMIC_MACRO_FEEDBACK_OFF
    help
      Select host keyboard layout. US/UK/FI enable full punctuated output.
      Other locales use plain mode (letters, digits, space only) with correct
      character mapping for that layout.

config ZMK_BEHAVIOR_DYNAMIC_MACRO_LOCALE_US
    bool "US QWERTY (full punctuation)"

config ZMK_BEHAVIOR_DYNAMIC_MACRO_LOCALE_UK
    bool "UK QWERTY (full punctuation)"

config ZMK_BEHAVIOR_DYNAMIC_MACRO_LOCALE_DE
    bool "German QWERTZ (plain mode)"

config ZMK_BEHAVIOR_DYNAMIC_MACRO_LOCALE_FR
    bool "French AZERTY (plain mode)"

config ZMK_BEHAVIOR_DYNAMIC_MACRO_LOCALE_FI
    bool "Finnish QWERTY (full punctuation)"

endchoice

config ZMK_BEHAVIOR_DYNAMIC_MACRO_LOCALE
    int
    default 0 if ZMK_BEHAVIOR_DYNAMIC_MACRO_LOCALE_US
    default 1 if ZMK_BEHAVIOR_DYNAMIC_MACRO_LOCALE_UK
    default 2 if ZMK_BEHAVIOR_DYNAMIC_MACRO_LOCALE_DE
    default 3 if ZMK_BEHAVIOR_DYNAMIC_MACRO_LOCALE_FR
    default 4 if ZMK_BEHAVIOR_DYNAMIC_MACRO_LOCALE_FI
    default 0

choice ZMK_BEHAVIOR_DYNAMIC_MACRO_FEEDBACK_STYLE_CHOICE
    prompt "Typed feedback style"
    default ZMK_BEHAVIOR_DYNAMIC_MACRO_FEEDBACK_STYLE_FULL
    depends on !ZMK_BEHAVIOR_DYNAMIC_MACRO_FEEDBACK_OFF

config ZMK_BEHAVIOR_DYNAMIC_MACRO_FEEDBACK_STYLE_FULL
    bool "Full text ([DM REC], [DM SAVED N3])"

config ZMK_BEHAVIOR_DYNAMIC_MACRO_FEEDBACK_STYLE_ARROW
    bool "Arrow grammar (>*, >N3, -N3)"
    depends on ZMK_BEHAVIOR_DYNAMIC_MACRO_LOCALE_US || ZMK_BEHAVIOR_DYNAMIC_MACRO_LOCALE_UK || \
              ZMK_BEHAVIOR_DYNAMIC_MACRO_LOCALE_FI
    help
      Note: if a persisted ARROW style is loaded on a build that does not support it (e.g.
      after switching locale to DE/FR), it is silently ignored and FULL is used instead.

endchoice

config ZMK_BEHAVIOR_DYNAMIC_MACRO_FEEDBACK_STYLE
    int
    default 0 if ZMK_BEHAVIOR_DYNAMIC_MACRO_FEEDBACK_STYLE_FULL
    default 1 if ZMK_BEHAVIOR_DYNAMIC_MACRO_FEEDBACK_STYLE_ARROW
    default 0

config ZMK_BEHAVIOR_DYNAMIC_MACRO_FEEDBACK_AUTO_ERASE
    bool "Auto-erase feedback after display"
    default n
    depends on !ZMK_BEHAVIOR_DYNAMIC_MACRO_FEEDBACK_OFF
    help
      Automatically delete typed feedback output after a configurable delay
      by emitting backspace keycodes. Cancelled if user types before the
      delay expires. Status output is excluded (it is informational and may be
      long).

config ZMK_BEHAVIOR_DYNAMIC_MACRO_FEEDBACK_ERASE_DELAY
    int "Auto-erase delay in ms"
    default 1000
    range 500 10000
    depends on ZMK_BEHAVIOR_DYNAMIC_MACRO_FEEDBACK_AUTO_ERASE

choice ZMK_BEHAVIOR_DYNAMIC_MACRO_STATUS_DETAIL_CHOICE
    prompt "Status key output detail"
    default ZMK_BEHAVIOR_DYNAMIC_MACRO_STATUS_FULL if ZMK_BEHAVIOR_DYNAMIC_MACRO_FEEDBACK_VERBOSE
    default ZMK_BEHAVIOR_DYNAMIC_MACRO_STATUS_USED_PREVIEW if ZMK_BEHAVIOR_DYNAMIC_MACRO_FEEDBACK_BASIC
    default ZMK_BEHAVIOR_DYNAMIC_MACRO_STATUS_USED_PREVIEW if ZMK_BEHAVIOR_DYNAMIC_MACRO_FEEDBACK_COMMAND
    default ZMK_BEHAVIOR_DYNAMIC_MACRO_STATUS_USED if ZMK_BEHAVIOR_DYNAMIC_MACRO_FEEDBACK_ERROR
    default ZMK_BEHAVIOR_DYNAMIC_MACRO_STATUS_OFF
    help
      Controls output detail when pressing the STATUS key. Defaults follow
      feedback level but can be overridden independently.

config ZMK_BEHAVIOR_DYNAMIC_MACRO_STATUS_OFF
    bool "Off (no status output)"

config ZMK_BEHAVIOR_DYNAMIC_MACRO_STATUS_COUNT
    bool "Count only (filled/total)"

config ZMK_BEHAVIOR_DYNAMIC_MACRO_STATUS_USED
    bool "Used slots (no preview)"

config ZMK_BEHAVIOR_DYNAMIC_MACRO_STATUS_USED_PREVIEW
    bool "Used slots with preview"

config ZMK_BEHAVIOR_DYNAMIC_MACRO_STATUS_FULL
    bool "Full listing (all slots)"

endchoice

config ZMK_BEHAVIOR_DYNAMIC_MACRO_STATUS_DETAIL
    int
    default 0 if ZMK_BEHAVIOR_DYNAMIC_MACRO_STATUS_OFF
    default 1 if ZMK_BEHAVIOR_DYNAMIC_MACRO_STATUS_COUNT
    default 2 if ZMK_BEHAVIOR_DYNAMIC_MACRO_STATUS_USED
    default 3 if ZMK_BEHAVIOR_DYNAMIC_MACRO_STATUS_USED_PREVIEW
    default 4 if ZMK_BEHAVIOR_DYNAMIC_MACRO_STATUS_FULL

config ZMK_BEHAVIOR_DYNAMIC_MACRO_STATUS_HEADER_SEP
    string "Status header-to-first-slot separator"
    default " || "
    help
      Status output is a SINGLE line: the header and each macro are joined by
      separators rather than newlines, so an accidental status press cannot fire
      a return in the wrong context. This joins the header to the first macro.
      Setting it to a value containing a newline ("\n") opts back into multi-line
      output at your own risk.

config ZMK_BEHAVIOR_DYNAMIC_MACRO_STATUS_SLOT_SEP
    string "Status slot-to-slot separator"
    default " | "
    help
      Joins each macro to the previous one in the single-line status output. As
      with the header separator, a newline value opts back into multi-line.

config ZMK_BEHAVIOR_DYNAMIC_MACRO_TEST_RELOAD
    bool "Test-only: DM_TEST_RELOAD command to simulate NVS reboot"
    default n
    depends on ZMK_BEHAVIOR_DYNAMIC_MACRO_PERSIST
    help
      Adds a DM_TEST_RELOAD command that zeroes all slot data in RAM
      and reloads from NVS settings, simulating a power cycle.
      For testing only.

config ZMK_BEHAVIOR_DYNAMIC_MACRO_EVENTS
    bool "Enable event notifications for display widgets"
    default n
    help
      Broadcasts ZMK events on state changes (recording, playback, save, etc.)
      for external display widgets to subscribe to. Also enables query API for
      slot contents.

endif

# The native_sim flash simulator defaults to a file backing (./flash.bin,
# relative to the process working directory). ZMK's run-test.sh runs every
# test binary from one shared directory, up to four in parallel, so any two
# NVS tests would share — and corrupt — the same flash file, and a previous
# run's slots would leak into the next. Backing the flash with RAM gives each
# test process a pristine, private flash; DM_TEST_RELOAD still exercises the
# full settings/NVS round-trip in-process. Gated on the test-only RELOAD
# symbol so production native builds are unaffected.
config NATIVE_EXTRA_CMDLINE_ARGS
    string
    depends on ARCH_POSIX
    default "--flash_in_ram" if ZMK_BEHAVIOR_DYNAMIC_MACRO_TEST_RELOAD && FLASH_SIMULATOR
```

## dts/bindings/behaviors/zmk,behavior-dynamic-macro.yaml
```yaml
# Copyright (c) 2026 Benjamin H
# SPDX-License-Identifier: MIT

description: |
  Dynamic Macro behavior for recording and playing back key sequences.
  param1 selects the command; param2 provides the slot index (for slot
  commands) or the delay in ms (for DM_DELAY, where 0 means the Kconfig
  default ZMK_BEHAVIOR_DYNAMIC_MACRO_DELAY_MS).

  Commands (param1):
    0 (DM_REC)      - Start recording
    1 (DM_STP)      - Stop recording
    2 (DM_DEL)      - Delete mode
    3 (DM_STATE)    - Show status
    4 (DM_MOV)      - Move mode
    5 (DM_SLOT_NVS) - NVS slot (play/assign)
    6 (DM_SLOT_RAM) - RAM slot (play/assign)
    7 (DM_PREVIEW)  - Preview mode
    13 (DM_TOG)     - Toggle recording (start when idle, stop when recording)
    14 (DM_DELAY)   - Insert a delay marker (recording only; param2 = ms, 0 = default)

compatible: "zmk,behavior-dynamic-macro"

include: two_param.yaml
```
