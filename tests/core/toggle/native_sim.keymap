#include "../behavior_keymap.dtsi"

&kscan {
    events = <
        /* TOG #1: idle -> start recording */
        ZMK_MOCK_PRESS(4,0,10)
        ZMK_MOCK_RELEASE(4,0,10)
        /* A (recorded) */
        ZMK_MOCK_PRESS(3,0,10)
        ZMK_MOCK_RELEASE(3,0,10)
        /* TOG #2: recording -> stop (pending assign) */
        ZMK_MOCK_PRESS(4,0,10)
        ZMK_MOCK_RELEASE(4,0,10)
        /* TOG #3: not recording -> start again, discarding the unassigned take */
        ZMK_MOCK_PRESS(4,0,10)
        ZMK_MOCK_RELEASE(4,0,10)
        /* A (recorded) */
        ZMK_MOCK_PRESS(3,0,10)
        ZMK_MOCK_RELEASE(3,0,10)
        /* TOG #4: recording -> stop (pending assign) */
        ZMK_MOCK_PRESS(4,0,10)
        ZMK_MOCK_RELEASE(4,0,10)
        /* SLOT_RAM 0 (assign) */
        ZMK_MOCK_PRESS(1,0,10)
        ZMK_MOCK_RELEASE(1,0,10)
        /* SLOT_RAM 0 (play): should be A */
        ZMK_MOCK_PRESS(1,0,2000)
        ZMK_MOCK_RELEASE(1,0,10)
    >;
};
